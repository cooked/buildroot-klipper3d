## Config.in
```kconfig
source "$BR2_EXTERNAL_K3D_PATH/package/klipper3d/Config.in"
source "$BR2_EXTERNAL_K3D_PATH/package/klipper3d-wrecklab/Config.in"
source "$BR2_EXTERNAL_K3D_PATH/package/klipper3d-repl/Config.in"
```

## configs/raspberrypi4_klipper3d_defconfig
```kconfig
BR2_arm=y
BR2_cortex_a72=y
BR2_ARM_FPU_NEON_VFPV4=y
BR2_PACKAGE_HOST_LINUX_HEADERS_CUSTOM_5_10=y
BR2_TOOLCHAIN_BUILDROOT_CXX=y
BR2_INIT_SYSTEMD=y
# BR2_TARGET_GENERIC_GETTY is not set
BR2_SYSTEM_DHCP="eth0"
BR2_SYSTEM_DEFAULT_PATH="/bin:/sbin:/usr/bin:/usr/sbin"
BR2_ROOTFS_USERS_TABLES="$(BR2_EXTERNAL)/board/raspberrypi/users.config"
BR2_ROOTFS_OVERLAY="$(BR2_EXTERNAL)/board/raspberrypi/rootfs"
BR2_ROOTFS_POST_BUILD_SCRIPT="board/raspberrypi4/post-build.sh"
BR2_ROOTFS_POST_IMAGE_SCRIPT="board/raspberrypi4/post-image.sh"
BR2_LINUX_KERNEL=y
BR2_LINUX_KERNEL_CUSTOM_TARBALL=y
BR2_LINUX_KERNEL_CUSTOM_TARBALL_LOCATION="$(call github,raspberrypi,linux,0b54dbda3cca2beb51e236a25738784e90853b64)/linux-0b54dbda3cca2beb51e236a25738784e90853b64.tar.gz"
BR2_LINUX_KERNEL_DEFCONFIG="bcm2711"
BR2_LINUX_KERNEL_DTS_SUPPORT=y
BR2_LINUX_KERNEL_INTREE_DTS_NAME="bcm2711-rpi-4-b"
BR2_LINUX_KERNEL_NEEDS_HOST_OPENSSL=y
BR2_PACKAGE_GIT=y
BR2_PACKAGE_BRCMFMAC_SDIO_FIRMWARE_RPI=y
BR2_PACKAGE_BRCMFMAC_SDIO_FIRMWARE_RPI_WIFI=y
BR2_PACKAGE_RPI_FIRMWARE=y
BR2_PACKAGE_RPI_FIRMWARE_VARIANT_PI4=y
BR2_PACKAGE_RPI_FIRMWARE_CONFIG_FILE="$(BR2_EXTERNAL)/board/raspberrypi/config_4_uart0.txt"
BR2_PACKAGE_RPI_FIRMWARE_CMDLINE_FILE="$(BR2_EXTERNAL)/board/raspberrypi/cmdline_noconsole.txt"
BR2_PACKAGE_PYTHON3_PY_PYC=y
BR2_PACKAGE_PYTHON_DBUS_NEXT=y
BR2_PACKAGE_PYTHON_DISTRO=y
BR2_PACKAGE_PYTHON_LMDB=y
BR2_PACKAGE_PYTHON_PAHO_MQTT=y
BR2_PACKAGE_PYTHON_PERIPHERY=y
BR2_PACKAGE_PYTHON_PILLOW=y
BR2_PACKAGE_PYTHON_PYINOTIFY=y
BR2_PACKAGE_PYTHON_SERIAL_ASYNCIO=y
BR2_PACKAGE_PYTHON_TORNADO=y
BR2_PACKAGE_PYTHON_ZEROCONF=y
BR2_PACKAGE_LIBSODIUM=y
BR2_PACKAGE_LIBCURL=y
BR2_PACKAGE_DROPBEAR=y
BR2_PACKAGE_IWD=y
BR2_PACKAGE_NGINX=y
BR2_PACKAGE_OPENRESOLV=y
BR2_PACKAGE_SUDO=y
BR2_PACKAGE_NANO=y
BR2_TARGET_ROOTFS_EXT2=y
BR2_TARGET_ROOTFS_EXT2_4=y
BR2_TARGET_ROOTFS_EXT2_SIZE="500M"
# BR2_TARGET_ROOTFS_TAR is not set
BR2_PACKAGE_HOST_DOSFSTOOLS=y
BR2_PACKAGE_HOST_GENIMAGE=y
BR2_PACKAGE_HOST_MTOOLS=y
BR2_PACKAGE_KLIPPER3D_USER_ROOT=y
BR2_PACKAGE_KLIPPER3D_PRNT_XYZ=y
BR2_PACKAGE_KLIPPER3D_WRECKLAB=y
BR2_PACKAGE_KLIPPER3D_WRECKLAB_PHAT1=y
BR2_PACKAGE_KLIPPER3D_REPL=y
```

## package/klipper3d-repl/Config.in
```kconfig
config BR2_PACKAGE_KLIPPER3D_REPL
	bool "klipper3d-repl"
	
	select BR2_PACKAGE_PYTHON_PROMPT_TOOLKIT
	select BR2_PACKAGE_PYTHON_PYGMENTS

	help
	  The missing Klipper command line.

	  https://github.com/unjordy/klipper-repl


if BR2_PACKAGE_KLIPPER3D_REPL

endif
```

## package/klipper3d-wrecklab/Config.in
```kconfig
config BR2_PACKAGE_KLIPPER3D_WRECKLAB
	bool "klipper3d-wrecklab"
	
	select BR2_PACKAGE_KLIPPER3D

	help
	  WrecklabOS is a Klipper3d addon that provide supports for  
	  Wrecklab's printHAT control boards.

	  https://github.com/wreck-lab/wrecklabOS


if BR2_PACKAGE_KLIPPER3D_WRECKLAB

config BR2_PACKAGE_KLIPPER3D_WRECKLAB_FIRSTRUN
      bool "Flash the MCU on first system run"
      help
        Selecting this option will add a script and file for the system 
		to automatically try to flash the MCU of the connected control
		board (note that the control board needs to be put in bootloader
		mode manually)

endif
```

## package/klipper3d/Config.in
```kconfig
config BR2_PACKAGE_KLIPPER3D
	bool "klipper3d"
	
	select BR2_PACKAGE_LIBFFI
	select BR2_PACKAGE_LIBUSB
	select BR2_PACKAGE_LIBUSB_DEV
	select BR2_PACKAGE_PYTHON3
	select BR2_PACKAGE_PYTHON_PIP
	select BR2_PACKAGE_PYTHON_CFFI
	select BR2_PACKAGE_PYTHON_SERIAL
	select BR2_PACKAGE_PYTHON_GREENLET
	select BR2_PACKAGE_PYTHON_JINJA2
	select BR2_PACKAGE_PYTHON_CAN
	select BR2_PACKAGE_PYTHON_MARKUPSAFE
	select BR2_PACKAGE_STM32FLASH
	select BR2_PACKAGE_BINUTILS
	select BR2_PACKAGE_BINUTILS_TARGET
	select BR2_PACKAGE_PKGCONF

	help
	  Klipper is a 3d-Printer firmware. It combines the power of a 
	  general purpose computer with one or more micro-controllers.

	  https://github.com/Klipper3d/klipper


if BR2_PACKAGE_KLIPPER3D

config BR2_PACKAGE_KLIPPER3D_SRC_CONFIG
	string "Klipper MCU kconfig file"
	default "$(BR2_EXTERNAL)/package/klipper3d/klipper_default.config"
	help
	  Provide a Klipper config file matching your 3D printing hardware or 
	  run "make klipper3d-menuconfig".
	  
endif
```
